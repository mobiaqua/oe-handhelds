## oe/conf/distro/mobiaqua-car.conf
```bitbake
#@TYPE: Distribution
#@NAME: mobiaqua
#@DESCRIPTION: Distribution configuration for MobiAqua Car

require conf/distro/mobiaqua.conf

DISTRO = "mobiaqua-car"
DISTRO_NAME = "MobiAqua Car"

PREFERRED_PROVIDER_virtual/libgl = "mesa-dri"
```

## oe/conf/distro/mobiaqua-pda-pxa250.conf
```bitbake
#@TYPE: Distribution
#@NAME: mobiaqua-pda-pxa250
#@DESCRIPTION: Distribution configuration for PDA PXA250

require conf/distro/mobiaqua.conf

DISTRO = "mobiaqua-pda-pxa250"
DISTRO_NAME = "MobiAqua PDA PXA250"
```

## oe/conf/distro/mobiaqua-pda-pxa25x.conf
```bitbake
#@TYPE: Distribution
#@NAME: mobiaqua-pda-pxa25x
#@DESCRIPTION: Distribution configuration for PDA PXA25x

require conf/distro/mobiaqua.conf

DISTRO = "mobiaqua-pda-pxa25x"
DISTRO_NAME = "MobiAqua PDA PXA25x"
```

## oe/conf/distro/mobiaqua-tv.conf
```bitbake
#@TYPE: Distribution
#@NAME: mobiaqua-tv
#@DESCRIPTION: Distribution configuration for MobiAqua TV

require conf/distro/mobiaqua.conf

DISTRO = "mobiaqua-tv"
DISTRO_NAME = "MobiAqua TV"

DISTRO_FEATURES += "nls"

PREFERRED_PROVIDER_hotplug = "udev"
IMAGE_DEV_MANAGER = "udev"
DISTRO_XORG_CONFIG_MANAGER = "udev"

USE_NLS = "yes"
```

## oe/conf/machine/h2200.conf
```bitbake
#@TYPE: Machine
#@NAME: HP iPAQ h22xx
#@DESCRIPTION: Machine configuration for the HP iPAQ h22xx

require conf/machine/include/common.inc

PREFERRED_PROVIDER_virtual/kernel = "linux-handhelds-2.6"

OVERRIDES .= ":${FEED_ARCH}"

IMAGE_FSTYPES = "tar.gz"
```

## oe/conf/machine/igep0030.conf
```bitbake
#@TYPE: Machine
#@NAME: IGEP machine
#@DESCRIPTION: Machine configuration for the IGEPv3.0 board
TARGET_ARCH = "arm"

TARGET_FPU_arm = "hard"
ARM_FP_ABI = "hardfp"

GUI_MACHINE_CLASS = "bigscreen"

include conf/machine/include/tune-cortexa8.inc

SERIAL_CONSOLE = "115200 ttyS2"

PREFERRED_PROVIDER_virtual/kernel = "linux-igep"
PREFERRED_PROVIDER_virtual/bootloader = "u-boot-igep"

KERNEL_IMAGETYPE = "zImage"

UBOOT_ENTRYPOINT = "0x80008000"
UBOOT_LOADADDRESS = "0x80008000"

OVERRIDES .= ":${FEED_ARCH}"

IMAGE_FSTYPES = "tar.gz"
```

## oe/conf/machine/include/omap4.inc
```bitbake
SOC_FAMILY = "omap4"
TARGET_ARCH = "arm"

#MobiAqua: omap4 is a9 not a8
require conf/machine/include/tune-cortexa9.inc
PREFERRED_PROVIDER_virtual/kernel = "linux-omap"
# Increase this everytime you change something in the kernel
MACHINE_KERNEL_PR = "r101"

KERNEL_IMAGETYPE = "uImage"

UBOOT_ENTRYPOINT = "0x80008000"
UBOOT_LOADADDRESS = "0x80008000"

EXTRA_IMAGEDEPENDS += "u-boot x-load"
```

## oe/conf/machine/pandaboard.conf
```bitbake
#@TYPE: Machine
#@NAME: OMAP4430 PandaBoard
#@DESCRIPTION: Machine configuration for the PandaBoard

require conf/machine/include/omap4.inc

TARGET_FPU_arm = "hard"
ARM_FP_ABI = "hardfp"
ARM_INSTRUCTION_SET = "thumb"

PREFERRED_PROVIDER_virtual/bootloader = "u-boot-pandaboard"
PREFERRED_PROVIDER_virtual/kernel = "linux-omap4"

GUI_MACHINE_CLASS = "bigscreen"

SERIAL_CONSOLE = "115200 ttyO2"

OVERRIDES .= ":${FEED_ARCH}"

IMAGE_FSTYPES = "tar.gz"
```

## oe/conf/machine/pda-pxa25x.conf
```bitbake
#@TYPE: Machine
#@NAME: PXA25x
#@DESCRIPTION: Machine configuration for the PDA with PXA25x

require conf/machine/include/common.inc
require conf/machine/include/tune-xscale.inc

PREFERRED_PROVIDER_virtual/kernel = "linux-handhelds-2.6"

ROOT_FLASH_SIZE = "16"
EXTRA_IMAGECMD_jffs2 = "-e 0x40000 -p ; echo '${IMAGE_NAME} ${IMAGE_NAME}.rootfs.jffs2 - root' >> ${DEPLOY_DIR_IMAGE}/reflash.ctl"
IMAGE_FSTYPES = "jffs2 tar.gz"

OVERRIDES .= ":${FEED_ARCH}"

PCMCIA_MANAGER = "pcmciautils"
```

## oe/conf/machine/pda-sa1110.conf
```bitbake
#@TYPE: Machine
#@NAME: sa1100
#@DESCRIPTION: Machine configuration for the PDA with SA1100

require conf/machine/include/common.inc
require conf/machine/include/tune-strongarm.inc

PREFERRED_PROVIDER_virtual/kernel = "linux-handhelds-2.6"

ROOT_FLASH_SIZE = "16"
EXTRA_IMAGECMD_jffs2 = "-e 0x40000 -p ; echo '${IMAGE_NAME} ${IMAGE_NAME}.rootfs.jffs2 - root' >> ${DEPLOY_DIR_IMAGE}/reflash.ctl"
IMAGE_FSTYPES = "jffs2 tar.gz"

OVERRIDES .= ":${FEED_ARCH}"

PCMCIA_MANAGER = "pcmciautils"

SERIAL_CONSOLE = "115200 ttySA0 vt100"
```
